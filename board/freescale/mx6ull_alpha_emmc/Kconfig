## board/freescale/mx6ull_alpha_emmc/Kconfig
```kconfig
if TARGET_MX6ULL_ALPHA_EMMC

config SYS_BOARD
	default "mx6ull_alpha_emmc"

config SYS_VENDOR
	default "freescale"

config SYS_SOC
	default "mx6"

config SYS_CONFIG_NAME
	default "mx6ull_alpha_emmc"

endif
```

## menuconfig/Kconfig
```kconfig
menu "My test menu two"

menu "My test menu two test 1"

config MY_MENU_THREE_TEST1
	bool "my menu two test 1"
	help
        This is a empty config, just for my menu two test 1!

config MY_MENU_THREE_TEST2
	bool "my menu two test 2"
    depends on MY_MENU_THREE_TEST1
	help
        This is a empty config, just for my menu two test 2 ,depend on MY_MENU_THREE_TEST1!

endmenu

config MY_MENU_CHOICE_TEST1
    bool "my choise test enable"

choice
	prompt "my choice test 1"
    depends on MY_MENU_CHOICE_TEST1
	default ARM

config ARM
	bool "ARM architecture"

config X86
	bool "x86 architecture"

endchoice

endmenu
```
